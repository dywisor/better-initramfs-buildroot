## package/Config.in
```kconfig
# br_pkg_repo autogen
menu "dywi/better-initramfs-buildroot [external repo]"
	source "package/askpass/Config.in"
	source "package/better-initramfs/Config.in"
	source "package/initramfs-hacks/Config.in"
	source "package/telinit/Config.in"
endmenu
```

## package/askpass/Config.in
```kconfig
config BR2_PACKAGE_ASKPASS
	bool "askpass"

	help
		Helper program for unlocking LUKS via SSH in better-initramfs

		https://bitbucket.org/piotrkarbowski/better-initramfs
```

## package/initramfs-hacks/Config.in
```kconfig
menuconfig BR2_PACKAGE_INITRAMFS_HACKS
	bool "initramfs hacks"

	depends on BR2_PACKAGE_BETTER_INITRAMFS
	depends on BR2_INIT_NONE

	help
		This package lets you select various rootfs modifications
		for running better-initramfs.

		Some are essential while others are just enhancements,
		see submenu.

if BR2_PACKAGE_INITRAMFS_HACKS

config BR2_PACKAGE_INITRAMFS_HACKS_DROPBEAR_CONFDIR
	bool "remove /etc/dropbear symlink"
	default y

	depends on BR2_PACKAGE_DROPBEAR

	help
		essential - better-initramfs fails to create /etc/dropbear if it is a symlink, so remove it.

config BR2_PACKAGE_INITRAMFS_HACKS_DROPBEAR_CONFDIR_HOST_KEY_RSA
	string "dropbear RSA host key file (INSECURE)"
	default ""

	depends on BR2_PACKAGE_DROPBEAR
	depends on BR2_PACKAGE_INITRAMFS_HACKS_DROPBEAR_CONFDIR

	help
		Include an RSA host key in the image so that it does not
		have to generated at initramfs runtime.

		INSECURE - do not use this for public releases.

config BR2_PACKAGE_INITRAMFS_HACKS_CRYPTSETUP_RUNDIR
	bool "create /run/cryptsetup"
	default y

	depends on BR2_PACKAGE_CRYPTSETUP

	help
		optional, but recommended - cryptsetup complains if this directory does not exist

endif # BR2_PACKAGE_INITRAMFS_HACKS
```

## package/telinit/Config.in
```kconfig
menuconfig BR2_PACKAGE_TELINIT
	bool "telinit"

	depends on BR2_PACKAGE_BETTER_INITRAMFS
	depends on BR2_INIT_NONE

	help
		A small telinit script for handling poweroff/reboot in initramfs.

		In order to make this work, you also need
		select the following options in your busybox configuration:

		  o CONFIG_FEATURE_CALL_TELINIT=y
		  o CONFIG_TELINIT_PATH="/sbin/telinit"

		The following programs need to be present in the initramfs
		(as busybox applets or via extra package):

		  o pkill
		  o mount
		  o umount
		  o sync
		  o swapoff
		  o true
		  o reboot
		  o poweroff
		  o sleep
		  o true (usually shell builtin)
		  o printf (usually shell builtin)

if BR2_PACKAGE_TELINIT

config BR2_PACKAGE_TELINIT_PATH
	string
	default "/sbin/telinit"

config BR2_PACKAGE_TELINIT_KILL_PROGS_KNOWN
	bool "kill well-known programs during poweroff/reboot"
	default y

	help
		If you select this option, telinit will kill the following programs
		if you selected the appropriate package:

		  o dropbear (BR2_PACKAGE_DROPBEAR)


config BR2_PACKAGE_TELINIT_KILL_PROGS_LIST
	string "additional programs to kill during poweroff/reboot"

endif # BR2_PACKAGE_TELINIT
```
